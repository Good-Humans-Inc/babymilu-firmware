## main/Kconfig.projbuild
```kconfig
menu "EchoEar BabyMilu Ground Firmware Stage 1"

config ECHOEAR_BABYMILU_OTA_URL
    string "BabyMilu OTA/config hydration URL"
    default "http://35.225.248.38:8000/babymilu/ota/"
    help
        Full HTTP URL used at boot with Device-Id/X-Device-Id headers.
        Runtime manifest values may override and persist websocket, mqtt,
        server_time, and firmware metadata.

config ECHOEAR_BABYMILU_WEBSOCKET_URL
    string "BabyMilu WebSocket URL"
    default "ws://35.225.248.38:8000/babymilu/v1/"
    help
        Full WebSocket URL. The firmware appends device_id, client_id, and
        canonical connectionType query parameters at runtime.

config ECHOEAR_BABYMILU_MQTT_URL
    string "BabyMilu MQTT broker URL"
    default "mqtt://35.225.248.38:1883"
    help
        Full MQTT endpoint URL. OTA hydration may override this value and
        provide per-device topics.

config ECHOEAR_BABYMILU_FIRESTORE_PROJECT
    string "Firestore project for device Wi-Fi ranking reads"
    default "composed-augury-469200-g6"

config ECHOEAR_BABYMILU_ANIMATION_BIN_URL
    string "Optional remote test.bin animation bundle URL"
    default ""
    help
        Optional read-only HTTP(S) URL used by the animation updater. When set,
        the updater checks this test.bin plus sibling startup.gif/startup.wav
        unless explicit animation URLs are persisted at runtime.

config ECHOEAR_BABYMILU_ERROR_UPLOAD_URL
    string "Existing BabyMilu error-log upload endpoint"
    default "https://upload-error-log-tmdtlnu7zq-uc.a.run.app"
    help
        Existing upload-error-log endpoint. Firmware uploads /sdcard/err.txt
        as multipart/form-data with device_id, timestamp, and file=err.txt.

config ECHOEAR_BABYMILU_ERROR_UPLOAD_API_KEY
    string "Existing BabyMilu error-log upload API key"
    default "test-key-123"

config ECHOEAR_BABYMILU_ENABLE_FIRMWARE_UPDATE
    bool "Enable firmware binary update from OTA manifest metadata"
    default y
    help
        Only runs when the manifest includes firmware.version and firmware.url.
        Activation code/challenge flow is intentionally not implemented.

config ECHOEAR_BABYMILU_ALLOW_MENUCONFIG_WIFI_FALLBACK
    bool "Allow menuconfig Wi-Fi fallback if no saved credentials exist"
    default n
    help
        Saved credentials and BLE/app provisioning are the primary path. This
        fallback is for isolated bench bring-up only.

config ECHOEAR_BABYMILU_WIFI_FALLBACK_SSID
    string "Bench Wi-Fi fallback SSID"
    default ""
    depends on ECHOEAR_BABYMILU_ALLOW_MENUCONFIG_WIFI_FALLBACK

config ECHOEAR_BABYMILU_WIFI_FALLBACK_PASSWORD
    string "Bench Wi-Fi fallback password"
    default ""
    depends on ECHOEAR_BABYMILU_ALLOW_MENUCONFIG_WIFI_FALLBACK

config USE_AUDIO_PROCESSOR
    bool "Enable ESP-SR AFE Audio Processor"
    default y
    depends on IDF_TARGET_ESP32S3 && SPIRAM

config USE_DEVICE_AEC
    bool "Enable Device-Side AEC"
    default y
    depends on USE_AUDIO_PROCESSOR

choice WAKE_WORD_TYPE
    prompt "Wake Word Implementation Type"
    default USE_CUSTOM_WAKE_WORD if IDF_TARGET_ESP32S3 && SPIRAM
    default WAKE_WORD_DISABLED
    depends on USE_AUDIO_PROCESSOR
    help
        Choose whether local wake word detection is disabled or handled by
        the ESP-SR MultiNet command model.

    config WAKE_WORD_DISABLED
        bool "Disabled"
        help
            Disable local wake word detection.

    config USE_CUSTOM_WAKE_WORD
        bool "Multinet model (Custom Wake Word)"
        depends on IDF_TARGET_ESP32S3 && SPIRAM
        help
            Detect the configured custom wake phrase with ESP-SR MultiNet.

endchoice

config CUSTOM_WAKE_WORD
    string "Custom Wake Word"
    default "xiao tu dou"
    depends on USE_CUSTOM_WAKE_WORD
    help
        Custom wake phrase in pinyin, separated by spaces.

config CUSTOM_WAKE_WORD_DISPLAY
    string "Custom Wake Word Display"
    default "xiao tu dou"
    depends on USE_CUSTOM_WAKE_WORD
    help
        Display/log text used when the custom wake phrase is detected.

config CUSTOM_WAKE_WORD_THRESHOLD
    int "Custom Wake Word Threshold (%)"
    default 20
    range 1 99
    depends on USE_CUSTOM_WAKE_WORD
    help
        Detection threshold. Smaller values are more sensitive.

endmenu
```

## sdkconfig.defaults
```kconfig
CONFIG_IDF_TARGET="esp32s3"
CONFIG_PARTITION_TABLE_CUSTOM=y
CONFIG_PARTITION_TABLE_CUSTOM_FILENAME="partitions.csv"
CONFIG_ESPTOOLPY_FLASHSIZE_16MB=y
CONFIG_ESPTOOLPY_FLASHMODE_QIO=y
CONFIG_ESP_DEFAULT_CPU_FREQ_MHZ_240=y
CONFIG_SPIRAM=y
CONFIG_SPIRAM_MODE_OCT=y
CONFIG_SPIRAM_SPEED_80M=y
CONFIG_SPIRAM_MALLOC_ALWAYSINTERNAL=0
CONFIG_FREERTOS_TASK_CREATE_ALLOW_EXT_MEM=y
CONFIG_SPIRAM_ALLOW_STACK_EXTERNAL_MEMORY=y
CONFIG_FREERTOS_HZ=1000
CONFIG_FREERTOS_WATCHPOINT_END_OF_STACK=y
CONFIG_ESP_WIFI_STATIC_RX_BUFFER_NUM=6
CONFIG_ESP_WIFI_DYNAMIC_RX_BUFFER_NUM=8
CONFIG_ESP_WIFI_DYNAMIC_RX_MGMT_BUFFER=y
CONFIG_ESP_WIFI_IRAM_OPT=n
CONFIG_ESP_WIFI_RX_IRAM_OPT=n
CONFIG_ESP_WIFI_ENTERPRISE_SUPPORT=n
CONFIG_BT_ENABLED=y
CONFIG_BT_CONTROLLER_ENABLED=y
CONFIG_BT_BLUEDROID_ENABLED=n
CONFIG_BT_NIMBLE_ENABLED=y
CONFIG_MBEDTLS_CERTIFICATE_BUNDLE=y
CONFIG_MBEDTLS_CERTIFICATE_BUNDLE_DEFAULT_FULL=y
CONFIG_NEWLIB_NANO_FORMAT=y
CONFIG_LV_USE_GIF=y
CONFIG_LV_GIF_CACHE_DECODE_DATA=y
CONFIG_LV_USE_BUILTIN_MALLOC=n
CONFIG_LV_USE_CLIB_MALLOC=y
CONFIG_LV_BUILD_EXAMPLES=n
CONFIG_USE_AUDIO_PROCESSOR=y
CONFIG_USE_DEVICE_AEC=y
CONFIG_USE_CUSTOM_WAKE_WORD=y
CONFIG_CUSTOM_WAKE_WORD="hey me low"
CONFIG_CUSTOM_WAKE_WORD_DISPLAY="hey milu"
CONFIG_CUSTOM_WAKE_WORD_THRESHOLD=10
CONFIG_SR_MN_CN_NONE=y
CONFIG_SR_MN_EN_MULTINET7_QUANT=y
CONFIG_ESP_WS_CLIENT_SEPARATE_TX_LOCK=y
CONFIG_ECHOEAR_BABYMILU_OTA_URL="http://35.225.248.38:8000/babymilu/ota/"
CONFIG_ECHOEAR_BABYMILU_WEBSOCKET_URL="ws://35.225.248.38:8000/babymilu/v1/"
CONFIG_ECHOEAR_BABYMILU_MQTT_URL="mqtt://35.225.248.38:1883"
CONFIG_ECHOEAR_BABYMILU_FIRESTORE_PROJECT="composed-augury-469200-g6"
CONFIG_ECHOEAR_BABYMILU_ERROR_UPLOAD_URL="https://upload-error-log-tmdtlnu7zq-uc.a.run.app"
CONFIG_ECHOEAR_BABYMILU_ERROR_UPLOAD_API_KEY="test-key-123"
CONFIG_ECHOEAR_BABYMILU_ENABLE_FIRMWARE_UPDATE=y
CONFIG_ECHOEAR_BABYMILU_ALLOW_MENUCONFIG_WIFI_FALLBACK=n
```

## sdkconfig.defaults.fcc-ultra-safe
```kconfig
CONFIG_BABYMILU_FCC_ULTRA_SAFE_MODE=y
CONFIG_BOARD_TYPE_ECHOEAR=y
CONFIG_USE_AUDIO_PROCESSOR=n
CONFIG_USE_AFE_WAKE_WORD=n
CONFIG_USE_ESP_WAKE_WORD=n
CONFIG_USE_DEVICE_AEC=n
CONFIG_USE_SERVER_AEC=n
CONFIG_USE_AUDIO_DEBUGGER=n
CONFIG_OTA_URL=""
```
